## board/esp32-s3-cam-ble/sdkconfig.defaults
```kconfig
CONFIG_BT_ENABLED=y
CONFIG_BT_NIMBLE_ENABLED=y
CONFIG_BT_NIMBLE_ROLE_PERIPHERAL=y
CONFIG_ESP32S3_DEFAULT_CPU_FREQ_240=y
CONFIG_PARTITION_TABLE_TWO_OTA=y
```
